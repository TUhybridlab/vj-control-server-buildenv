## conf/bblayers.conf
```bitbake
# LAYER_CONF_VERSION is increased each time build/conf/bblayers.conf
# changes incompatibly
LCONF_VERSION = "6"

BBPATH = "${TOPDIR}"
BBFILES ?= ""

BBLAYERS ?= " \
  YOCTO_BASE_PATH/meta \
  YOCTO_BASE_PATH/meta-yocto \
  YOCTO_BASE_PATH/meta-yocto-bsp \
  YOCTO_BASE_PATH/meta-raspberrypi \
  YOCTO_BASE_PATH/meta-openembedded/meta-oe \
  YOCTO_BASE_PATH/meta-openembedded/meta-python \
  YOCTO_BASE_PATH/meta-vj \
  "
BBLAYERS_NON_REMOVABLE ?= " \
  YOCTO_BASE_PATH/meta \
  YOCTO_BASE_PATH/meta-yocto \
  "
```
